## freedom-u-sdk/buildroot/package/tyrquake/Config.in
```kconfig
config BR2_PACKAGE_TYRQUAKE
	bool "TyrQuake"
	select BR2_PACKAGE_XORG7
	select BR2_PACKAGE_MESA3D
	select BR2_PACKAGE_XLIB_LIBXXF86VM
	select BR2_PACKAGE_XLIB_LIBXXF86DGA
	help

	  A portable Quake.
```

## freedom-u-sdk/buildroot/package/yamagiquake2/Config.in
```kconfig
config BR2_PACKAGE_YAMAGIQUAKE2
	bool "YamagiQuake2"
	select BR2_PACKAGE_XORG7
	select BR2_PACKAGE_MESA3D
	select BR2_PACKAGE_XLIB_LIBXXF86VM
	select BR2_PACKAGE_LIBVORBIS
	select BR2_PACKAGE_OPENAL
	select BR2_PACKAGE_SDL2
	select BR2_PACKAGE_ZLIB
	help

	  A portable Quake2.
```
